## nrf52840dk_build/Kconfig/Kconfig.shield
```kconfig
osource "c:/Work/nRF_VSCode/peripheral_uart_twi/boards/shields/*/Kconfig.shield"
osource "c:/Work/nRF_VSCode/peripheral_uart_twi1/boards/shields/*/Kconfig.shield"
osource "c:/Work/nRF_VSCode/weight_scale_application/boards/shields/*/Kconfig.shield"
osource "C:/ncs/v2.2.0/nrf/boards/shields/*/Kconfig.shield"
```
